## meta-training/meta-kernel-lab1-qemux86/conf/layer.conf
```bitbake
# We have a conf and classes directory, add to BBPATH
BBPATH := "${BBPATH}:${LAYERDIR}"

# We have a recipes directory, add to BBFILES
BBFILES := "${BBFILES} ${LAYERDIR}/recipes-*/*/*.bb \
	${LAYERDIR}/recipes-*/*/*.bbappend"

BBFILE_COLLECTIONS += "kernel-lab1-qemux86"
BBFILE_PATTERN_kernel-lab1-qemux86 := "^${LAYERDIR}/"
BBFILE_PRIORITY_kernel-lab1-qemux86 = "6"
```
